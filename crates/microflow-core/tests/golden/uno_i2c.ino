// Generated by microflow v0.12.0.
// Target board: Arduino Uno (uno).
// Sketch skeleton for 3 node(s).

// --- Includes ---
// Libraries not bundled with your board's core must be installed first:
// Arduino IDE > Sketch > Include Library > Manage Libraries…
#include <Wire.h>

// --- Declarations ---
// node btn-1 (Button)
const uint8_t button_btn_1_pin = 3;
bool button_btn_1_state = false;
// node i2c-1 (I2cDevice)
long i2c_i2c_1_value = 0;
bool i2c_i2c_1_trigger_prev0 = false;
// node led-1 (Led)
const uint8_t led_led_1_pin = 11;
bool led_led_1_on = false;

void setup() {
  // --- Setup ---
  pinMode(button_btn_1_pin, INPUT);
  Wire.begin();
  pinMode(led_led_1_pin, OUTPUT);
  digitalWrite(led_led_1_pin, LOW);
}

void loop() {
  static unsigned long previousMillis = 0;
  const unsigned long interval = 1; // ms; non-blocking scheduler tick
  unsigned long currentMillis = millis();
  if (currentMillis - previousMillis >= interval) {
    previousMillis = currentMillis;
    // --- Scheduled tasks ---
    button_btn_1_state = (digitalRead(button_btn_1_pin) == HIGH);
    bool i2c_i2c_1_trigger_now0 = (button_btn_1_state);
    bool i2c_i2c_1_trigger_fired0 = i2c_i2c_1_trigger_now0 && !i2c_i2c_1_trigger_prev0;
    i2c_i2c_1_trigger_prev0 = i2c_i2c_1_trigger_now0;
    bool i2c_i2c_1_due = false;
    if ((i2c_i2c_1_trigger_fired0)) { i2c_i2c_1_due = true; }
    if (i2c_i2c_1_due) {
      Wire.beginTransmission((uint8_t)64);
      Wire.write((uint8_t)0);
      Wire.endTransmission(false);
      Wire.requestFrom((uint8_t)64, (uint8_t)2);
      long i2c_i2c_1_acc = 0;
      for (uint8_t i2c_i2c_1_i = 0; i2c_i2c_1_i < 2 && Wire.available(); i2c_i2c_1_i++) {
        uint8_t i2c_i2c_1_b = Wire.read();
        i2c_i2c_1_acc = (i2c_i2c_1_acc << 8) | (long)i2c_i2c_1_b;
      }
      i2c_i2c_1_value = i2c_i2c_1_acc;
    }
    uint8_t led_led_1_brightness = (uint8_t)constrain((double)(i2c_i2c_1_value), 0.0, 255.0);
    analogWrite(led_led_1_pin, led_led_1_brightness);
    led_led_1_on = led_led_1_brightness > 0;
  }
}
