// Generated by microflow v0.11.3.
// Target board: Arduino Uno (uno).
// Sketch skeleton for 6 node(s).

// --- Includes ---
// Libraries not bundled with your board's core must be installed first:
// Arduino IDE > Sketch > Include Library > Manage Libraries…
#include <AccelStepper.h>
#include <LedControl.h>

// --- Declarations ---
// node btn-1 (Button)
const uint8_t button_btn_1_pin = 12;
bool button_btn_1_state = false;
// node matrix-1 (Matrix)
LedControl matrix_matrix_1(4, 5, 7, 1);
// note: 'value' selects a shape, but no shapes are configured — edge has no effect
// node osc-1 (Oscillator)
unsigned long oscillator_osc_1_start = 0;
double oscillator_osc_1_value = 0.0;
bool oscillator_osc_1_running = true;
// node piezo-1 (Piezo)
const uint8_t piezo_piezo_1_pin = 8;
bool piezo_piezo_1_trigger_prev0 = false;
// node rgb-1 (Rgb)
const uint8_t rgb_rgb_1_red_pin = 9;
uint8_t rgb_rgb_1_red = 0;
const uint8_t rgb_rgb_1_green_pin = 10;
uint8_t rgb_rgb_1_green = 0;
const uint8_t rgb_rgb_1_blue_pin = 6;
uint8_t rgb_rgb_1_blue = 0;
double rgb_rgb_1_a = 1.0;
// node stepper-1 (Stepper)
AccelStepper stepper_stepper_1(AccelStepper::DRIVER, 2, 3);
double stepper_stepper_1_value_prev0 = 0.0;

void setup() {
  // --- Setup ---
  pinMode(button_btn_1_pin, INPUT);
  for (int matrix_matrix_1_i = 0; matrix_matrix_1_i < 1; matrix_matrix_1_i++) {
    matrix_matrix_1.shutdown(matrix_matrix_1_i, false);
    matrix_matrix_1.setIntensity(matrix_matrix_1_i, 8);
    matrix_matrix_1.clearDisplay(matrix_matrix_1_i);
  }
  oscillator_osc_1_start = millis();
  pinMode(piezo_piezo_1_pin, OUTPUT);
  noTone(piezo_piezo_1_pin);
  pinMode(rgb_rgb_1_red_pin, OUTPUT);
  analogWrite(rgb_rgb_1_red_pin, 0);
  pinMode(rgb_rgb_1_green_pin, OUTPUT);
  analogWrite(rgb_rgb_1_green_pin, 0);
  pinMode(rgb_rgb_1_blue_pin, OUTPUT);
  analogWrite(rgb_rgb_1_blue_pin, 0);
  stepper_stepper_1.setMaxSpeed(200.0);
  stepper_stepper_1.setAcceleration(100.0);
}

void loop() {
  static unsigned long previousMillis = 0;
  const unsigned long interval = 1; // ms; non-blocking scheduler tick
  unsigned long currentMillis = millis();
  if (currentMillis - previousMillis >= interval) {
    previousMillis = currentMillis;
    // --- Scheduled tasks ---
    button_btn_1_state = (digitalRead(button_btn_1_pin) == HIGH);
    if (oscillator_osc_1_running) {
      double oscillator_osc_1_t = (double)(millis() - oscillator_osc_1_start) + 0.0;
      oscillator_osc_1_t = fmod(oscillator_osc_1_t, 1000.0);
      if (oscillator_osc_1_t < 0.0) { oscillator_osc_1_t += 1000.0; }
      oscillator_osc_1_value = 1.0 * (-1.0 + oscillator_osc_1_t * (2.0 / 1000.0)) + 0.0;
    }
    bool piezo_piezo_1_trigger_now0 = (button_btn_1_state);
    bool piezo_piezo_1_trigger_fired0 = piezo_piezo_1_trigger_now0 && !piezo_piezo_1_trigger_prev0;
    piezo_piezo_1_trigger_prev0 = piezo_piezo_1_trigger_now0;
    if ((piezo_piezo_1_trigger_fired0)) { tone(piezo_piezo_1_pin, 440, 500); }
    rgb_rgb_1_a = constrain(((double)(oscillator_osc_1_value)) / 100.0, 0.0, 1.0);
    analogWrite(rgb_rgb_1_red_pin, (uint8_t)((double)rgb_rgb_1_red * rgb_rgb_1_a));
    analogWrite(rgb_rgb_1_green_pin, (uint8_t)((double)rgb_rgb_1_green * rgb_rgb_1_a));
    analogWrite(rgb_rgb_1_blue_pin, (uint8_t)((double)rgb_rgb_1_blue * rgb_rgb_1_a));
    double stepper_stepper_1_value_now0 = ((double)(oscillator_osc_1_value));
    bool stepper_stepper_1_value_fired0 = (stepper_stepper_1_value_now0 != stepper_stepper_1_value_prev0);
    stepper_stepper_1_value_prev0 = stepper_stepper_1_value_now0;
    if (stepper_stepper_1_value_fired0) {
      long stepper_stepper_1_steps = (long)(((double)(oscillator_osc_1_value)));
      if (stepper_stepper_1_steps != 0) { stepper_stepper_1.move(stepper_stepper_1_steps); }
    }
    stepper_stepper_1.run();
  }
}
