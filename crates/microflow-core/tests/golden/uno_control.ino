// Generated by microflow v0.12.0.
// Target board: Arduino Uno (uno).
// Sketch skeleton for 4 node(s).

// --- Declarations ---
// node compare-1 (Compare)
bool compare_compare_1_result = false;
// node counter-1 (Counter)
double counter_counter_1_count = 0.0;
// node interval-1 (Interval)
unsigned long interval_interval_1_previous = 0;
unsigned long interval_interval_1_start = 0;
double interval_interval_1_value = 0.0;
bool interval_interval_1_fired = false;
bool interval_interval_1_running = true;
// node relay-1 (Relay)
const uint8_t relay_relay_1_pin = 7;
bool relay_relay_1_open = false;
bool relay_relay_1_true_prev0 = false;
bool relay_relay_1_false_prev0 = false;

void setup() {
  // --- Setup ---
  interval_interval_1_previous = millis();
  interval_interval_1_start = millis();
  pinMode(relay_relay_1_pin, OUTPUT);
  digitalWrite(relay_relay_1_pin, LOW);
}

void loop() {
  static unsigned long previousMillis = 0;
  const unsigned long interval = 1; // ms; non-blocking scheduler tick
  unsigned long currentMillis = millis();
  if (currentMillis - previousMillis >= interval) {
    previousMillis = currentMillis;
    // --- Scheduled tasks ---
    interval_interval_1_fired = false;
    if (interval_interval_1_running && millis() - interval_interval_1_previous >= 500UL) {
      interval_interval_1_previous += 500UL;
      interval_interval_1_value = (double)(millis() - interval_interval_1_start);
      interval_interval_1_fired = true;
    }
    if (interval_interval_1_fired) { counter_counter_1_count += 1.0; }
    compare_compare_1_result = (((double)(counter_counter_1_count)) == 10.0);
    bool relay_relay_1_true_now0 = (compare_compare_1_result);
    bool relay_relay_1_true_fired0 = relay_relay_1_true_now0 && !relay_relay_1_true_prev0;
    relay_relay_1_true_prev0 = relay_relay_1_true_now0;
    if ((relay_relay_1_true_fired0)) { digitalWrite(relay_relay_1_pin, HIGH); relay_relay_1_open = true; }
    bool relay_relay_1_false_now0 = ((!compare_compare_1_result));
    bool relay_relay_1_false_fired0 = relay_relay_1_false_now0 && !relay_relay_1_false_prev0;
    relay_relay_1_false_prev0 = relay_relay_1_false_now0;
    if ((relay_relay_1_false_fired0)) { digitalWrite(relay_relay_1_pin, LOW); relay_relay_1_open = false; }
  }
}
