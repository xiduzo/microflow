// Generated by microflow v0.12.0.
// Target board: Arduino Uno (uno).
// Sketch skeleton for 3 node(s).

// --- Includes ---
// Libraries not bundled with your board's core must be installed first:
// Arduino IDE > Sketch > Include Library > Manage Libraries…
#include <Wire.h>

// --- Declarations ---
// node led-1 (Led)
const uint8_t led_led_1_pin = 9;
bool led_led_1_on = false;
// node map-1 (RangeMap)
double range_map_map_1_value = 0.0;
// node sht-1 (I2cDevice)
long i2c_sht_1_value = 0;
unsigned long i2c_sht_1_previous = 0;
bool i2c_sht_1_pending = false;
unsigned long i2c_sht_1_requested_at = 0;

void setup() {
  // --- Setup ---
  pinMode(led_led_1_pin, OUTPUT);
  digitalWrite(led_led_1_pin, LOW);
  Wire.begin();
  Wire.beginTransmission((uint8_t)64);
  Wire.write((uint8_t)230);
  Wire.write((uint8_t)131);
  Wire.endTransmission();
  i2c_sht_1_previous = millis();
}

void loop() {
  static unsigned long previousMillis = 0;
  const unsigned long interval = 1; // ms; non-blocking scheduler tick
  unsigned long currentMillis = millis();
  if (currentMillis - previousMillis >= interval) {
    previousMillis = currentMillis;
    // --- Scheduled tasks ---
    bool i2c_sht_1_due = false;
    if (millis() - i2c_sht_1_previous >= 100UL) { i2c_sht_1_previous = millis(); i2c_sht_1_due = true; }
    if (i2c_sht_1_due && !i2c_sht_1_pending) {
      Wire.beginTransmission((uint8_t)64);
      Wire.write((uint8_t)243);
      Wire.endTransmission(true);
      i2c_sht_1_requested_at = millis();
      i2c_sht_1_pending = true;
    }
    if (i2c_sht_1_pending && millis() - i2c_sht_1_requested_at >= 30UL) {
      i2c_sht_1_pending = false;
      Wire.requestFrom((uint8_t)64, (uint8_t)2);
      long i2c_sht_1_acc = 0;
      for (uint8_t i2c_sht_1_i = 0; i2c_sht_1_i < 2 && Wire.available(); i2c_sht_1_i++) {
        uint8_t i2c_sht_1_b = Wire.read();
        i2c_sht_1_acc = (i2c_sht_1_acc << 8) | (long)i2c_sht_1_b;
      }
      i2c_sht_1_value = i2c_sht_1_acc;
    }
    range_map_map_1_value = round((((((double)(i2c_sht_1_value)) - 0.0) * (255.0 - 0.0) / (65535.0 - 0.0) + 0.0)) * 1.0) / 1.0;
    uint8_t led_led_1_brightness = (uint8_t)constrain((double)(range_map_map_1_value), 0.0, 255.0);
    analogWrite(led_led_1_pin, led_led_1_brightness);
    led_led_1_on = led_led_1_brightness > 0;
  }
}
