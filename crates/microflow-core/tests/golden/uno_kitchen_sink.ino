// Generated by microflow v0.12.0.
// Target board: Arduino Uno (uno).
// Sketch skeleton for 4 node(s).

// --- Includes ---
// Libraries not bundled with your board's core must be installed first:
// Arduino IDE > Sketch > Include Library > Manage Libraries…
#include <PubSubClient.h>
#include <WiFi.h>

// --- Declarations ---
// WiFi credentials (Cloud Nodes)
const char* wifi_ssid = "";
const char* wifi_password = "";
// node btn-1 (Button)
const uint8_t button_btn_1_pin = 4;
bool button_btn_1_state = false;
// node gizmo-1 (Gizmo)
// unsupported Node gizmo_1 (Gizmo): no emitter for this Node type — no code generated
// node led-1 (Led)
const uint8_t led_led_1_pin = 13;
bool led_led_1_on = false;
// note: input 'toggle' from node 'btn-1' (Button) output 'toggle' has no on-device value — edge ignored
// node mqtt-1 (Mqtt)
#warning "MQTT Node mqtt_1: missing network credentials — using REPLACE_ME placeholder; set WiFi SSID and broker before flashing"
const char* mqtt_mqtt_1_broker = "REPLACE_ME";
const uint16_t mqtt_mqtt_1_port = 1883;
const char* mqtt_mqtt_1_topic = "t";
const char* mqtt_mqtt_1_client_id = "microflow-mqtt_1";
WiFiClient mqtt_mqtt_1_wifi_client;
PubSubClient mqtt_mqtt_1_client(mqtt_mqtt_1_wifi_client);
void mqtt_mqtt_1_ensure_connected() {
  if (WiFi.status() != WL_CONNECTED) {
    return; // WiFi not up yet; retry on the next loop tick
  }
  if (!mqtt_mqtt_1_client.connected()) {
    mqtt_mqtt_1_client.setServer(mqtt_mqtt_1_broker, mqtt_mqtt_1_port);
    if (mqtt_mqtt_1_client.connect(mqtt_mqtt_1_client_id)) {
      // publish-only Node: nothing to subscribe
    }
  }
}
bool mqtt_mqtt_1_trigger_prev0 = false;

void setup() {
  // --- Setup ---
  // --- WiFi connect (Cloud Nodes) ---
  WiFi.mode(WIFI_STA);
  WiFi.begin(wifi_ssid, wifi_password);
  while (WiFi.status() != WL_CONNECTED) {
    yield();
  }
  pinMode(button_btn_1_pin, INPUT);
  pinMode(led_led_1_pin, OUTPUT);
  digitalWrite(led_led_1_pin, LOW);
  mqtt_mqtt_1_client.setServer(mqtt_mqtt_1_broker, mqtt_mqtt_1_port);
  mqtt_mqtt_1_ensure_connected();
}

void loop() {
  static unsigned long previousMillis = 0;
  const unsigned long interval = 1; // ms; non-blocking scheduler tick
  unsigned long currentMillis = millis();
  if (currentMillis - previousMillis >= interval) {
    previousMillis = currentMillis;
    // --- Scheduled tasks ---
    button_btn_1_state = (digitalRead(button_btn_1_pin) == HIGH);
    mqtt_mqtt_1_ensure_connected();
    mqtt_mqtt_1_client.loop();
    bool mqtt_mqtt_1_trigger_now0 = (button_btn_1_state);
    bool mqtt_mqtt_1_trigger_fired0 = mqtt_mqtt_1_trigger_now0 && !mqtt_mqtt_1_trigger_prev0;
    mqtt_mqtt_1_trigger_prev0 = mqtt_mqtt_1_trigger_now0;
    if (mqtt_mqtt_1_trigger_fired0 && mqtt_mqtt_1_client.connected()) {
      mqtt_mqtt_1_client.publish(mqtt_mqtt_1_topic, (((button_btn_1_state) ? String("true") : String("false"))).c_str());
    }
  }
}
