// Generated by microflow v0.11.3.
// Target board: Arduino Uno (uno).
// Sketch skeleton for 3 node(s).

// --- Declarations ---
// node btn-1 (Button)
const uint8_t button_btn_1_pin = 6;
bool button_btn_1_state = false;
// node led-1 (Led)
const uint8_t led_led_1_pin = 13;
bool led_led_1_on = false;
bool led_led_1_true_prev0 = false;
bool led_led_1_false_prev0 = false;
// node led-2 (Led)
const uint8_t led_led_2_pin = 5;
bool led_led_2_on = false;

void setup() {
  // --- Setup ---
  pinMode(button_btn_1_pin, INPUT_PULLUP);
  pinMode(led_led_1_pin, OUTPUT);
  digitalWrite(led_led_1_pin, LOW);
  pinMode(led_led_2_pin, OUTPUT);
  digitalWrite(led_led_2_pin, LOW);
}

void loop() {
  static unsigned long previousMillis = 0;
  const unsigned long interval = 1; // ms; non-blocking scheduler tick
  unsigned long currentMillis = millis();
  if (currentMillis - previousMillis >= interval) {
    previousMillis = currentMillis;
    // --- Scheduled tasks ---
    button_btn_1_state = (digitalRead(button_btn_1_pin) == LOW);
    bool led_led_1_true_now0 = (button_btn_1_state);
    bool led_led_1_true_fired0 = led_led_1_true_now0 && !led_led_1_true_prev0;
    led_led_1_true_prev0 = led_led_1_true_now0;
    if ((led_led_1_true_fired0)) { digitalWrite(led_led_1_pin, HIGH); led_led_1_on = true; }
    bool led_led_1_false_now0 = ((!button_btn_1_state));
    bool led_led_1_false_fired0 = led_led_1_false_now0 && !led_led_1_false_prev0;
    led_led_1_false_prev0 = led_led_1_false_now0;
    if ((led_led_1_false_fired0)) { digitalWrite(led_led_1_pin, LOW); led_led_1_on = false; }
    uint8_t led_led_2_brightness = (uint8_t)((button_btn_1_state) ? 1 : 0);
    analogWrite(led_led_2_pin, led_led_2_brightness);
    led_led_2_on = led_led_2_brightness > 0;
  }
}
